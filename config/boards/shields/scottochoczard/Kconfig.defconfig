## config/boards/shields/scottochoczard/Kconfig.defconfig
```kconfig
if SHIELD_SCOTTOCHOCZARD_LEFT

config ZMK_KEYBOARD_NAME
    default "scottochoczard"

config ZMK_SPLIT_ROLE_CENTRAL
    default y

endif

if SHIELD_SCOTTOCHOCZARD_LEFT || SHIELD_SCOTTOCHOCZARD_RIGHT

config ZMK_SPLIT
    default y

endif
```
